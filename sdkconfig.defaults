## sdkconfig.defaults
```kconfig
CONFIG_HTTPD_MAX_REQ_HDR_LEN=1024
CONFIG_LWIP_MAX_SOCKETS=16

# CONFIG_PARTITION_TABLE_SINGLE_APP_LARGE=y
CONFIG_PARTITION_TABLE_CUSTOM=y
CONFIG_PARTITION_TABLE_CUSTOM_FILENAME="partitions.csv"

CONFIG_ESPTOOLPY_FLASHFREQ_80M=y
CONFIG_ESPTOOLPY_FLASHFREQ="80m"
CONFIG_ESPTOOLPY_FLASHSIZE_4MB=y
CONFIG_ESPTOOLPY_FLASHSIZE="4MB"
CONFIG_ESP32C3_DEFAULT_CPU_FREQ_80=y
CONFIG_ESP32C3_DEFAULT_CPU_FREQ_MHZ=80
CONFIG_ESP32C3_REV_MIN_3=y
CONFIG_ESP32C3_REV_MIN=3
CONFIG_ESP32C3_DEBUG_OCDAWARE=y


CONFIG_BOOTLOADER_LOG_LEVEL=3

CONFIG_LV_FONT_MONTSERRAT_18=y
CONFIG_LV_FONT_DEFAULT_MONTSERRAT_18=y

CONFIG_LV_COLOR_DEPTH_16=y
CONFIG_LV_COLOR_DEPTH=16
CONFIG_LV_COLOR_16_SWAP=y
CONFIG_LV_INVERT_COLORS=y

CONFIG_LV_TFT_DISPLAY_CONTROLLER_ST7789=y
CONFIG_LV_TFT_DISPLAY_USER_CONTROLLER_ST7789=y
CONFIG_LV_TFT_DISPLAY_SPI2_HOST=y
CONFIG_LV_TFT_DISPLAY_SPI_TRANS_MODE_SIO=y

CONFIG_LV_DISP_SPI_MOSI=7
CONFIG_LV_DISP_SPI_CLK=6
CONFIG_LV_DISPLAY_USE_SPI_CS=y
CONFIG_LV_DISP_SPI_CS=10
CONFIG_LV_DISPLAY_USE_DC=y
CONFIG_LV_DISP_PIN_DC=5
CONFIG_LV_DISP_USE_RST=y
CONFIG_LV_DISP_PIN_RST=8
CONFIG_LV_DISP_PIN_BUSY=21

CONFIG_LV_DISP_BACKLIGHT_PWM=y
CONFIG_LV_DISP_PIN_BCKL=4
```
